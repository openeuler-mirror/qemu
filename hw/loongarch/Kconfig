## hw/loongarch/Kconfig
```kconfig
config LS7A_APIC
    bool

config LS7A_RTC
    bool

config LOONGSON3A
    bool

config MEM_HOTPLUG
    bool

config ACPI_LOONGARCH
    bool

config E1000E_PCI
    bool
```

## hw/sw64/Kconfig
```kconfig
config CORE3
    bool
    imply PCI_DEVICES
    imply TEST_DEVICES
    imply E1000_PCI
    select PCI_EXPRESS
    select SUN4V_RTC
    select VIRTIO_MMIO
    select SERIAL
    select VIRTIO_VGA
    select IDE_CMD646
    select ISA_BUS
    select PCKBD
    select MSI_NONBROKEN
```
